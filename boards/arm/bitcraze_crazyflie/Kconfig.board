## boards/arm/bitcraze_crazyflie/Kconfig.board
```kconfig
# STM32F4DISCOVERY board configuration

# Copyright (c) 2016 Linaro Limited.
# SPDX-License-Identifier: Apache-2.0

config BOARD_BITCRAZE_CRAZYFLIE
	bool "Bitcraze Crazyflie 2.1"
	depends on SOC_STM32F405XG
```

## boards/arm/bitcraze_crazyflie/Kconfig.defconfig
```kconfig
# STM32F4DISCOVERY board configuration

# Copyright (c) 2016 Linaro Limited.
# SPDX-License-Identifier: Apache-2.0

if BOARD_BITCRAZE_CRAZYFLIE

config BOARD
	default "bitcraze_crazyflie"

endif 
```
